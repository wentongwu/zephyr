## tests/subsys/debug/tracing/testcase.yaml
```yaml
common:
    tags: tracing debug
    harness: console
    harness_config:
      type: multi_line
      regex:
        - "thread_a: Hello World from (.*)!"
        - "thread_b: Hello World from (.*)!"
tests:
  tracing.backends.sysview:
    platform_whitelist: nrf52840_pca10056
    extra_configs:
      - CONFIG_SEGGER_SYSTEMVIEW=y
      - CONFIG_USE_SEGGER_RTT=y
  tracing.backends.ctf:
    platform_whitelist: native_posix
    extra_configs:
      - CONFIG_TRACING_CTF=y
  tracing.backends.cpu_stats:
    platform_whitelist: nrf52840_pca10056
    extra_configs:
      - CONFIG_TRACING_CPU_STATS=y
  tracing.backends.openocd:
    extra_configs:
      - CONFIG_OPENOCD_SUPPORT=y
    arch_exclude: posix xtensa
    platform_exclude: qemu_x86_64
  tracing.uart:
    platform_whitelist: sam_e70_xplained
    depends_on: usb_device usb_cdc
    extra_args: CONF_FILE="prj_uart.conf"
  tracing.usb:
    platform_whitelist: sam_e70_xplained
    depends_on: usb_device
    extra_args: CONF_FILE="prj_usb.conf"
  tracing.uart.data:
    platform_whitelist: sam_e70_xplained
    depends_on: usb_device usb_cdc
    extra_args: CONF_FILE="prj_uart_data.conf"
  tracing.usb.data:
    platform_whitelist: sam_e70_xplained
    depends_on: usb_device
    extra_args: CONF_FILE="prj_usb_data.conf"
  tracing.posix:
    platform_whitelist: native_posix
    extra_args: CONF_FILE="prj_posix.conf"
  tracing.posix.data:
    platform_whitelist: native_posix
    extra_args: CONF_FILE="prj_posix_data.conf"
```
